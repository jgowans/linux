## fs/guestmemfs/Kconfig
```kconfig
# SPDX-License-Identifier: GPL-2.0-only

config GUESTMEMFS_FS
	bool "Persistent Guest memory filesystem (guestmemfs)"
	help
	  An in-memory filesystem on top of reserved memory specified via
	  guestmemfs= cmdline argument.  Used for storing kernel state and
	  userspace memory which is preserved across kexec to support
	  live update of a hypervisor when running guest virtual machines.
	  Select this if you need the ability to persist memory for guest VMs
	  across kexec to do live update.
```

## fs/pkernfs/Kconfig
```kconfig
# SPDX-License-Identifier: GPL-2.0-only

config PKERNFS_FS
	bool "Persistent Kernel filesystem (pkernfs)"
	help
	  An in-memory filesystem on top of reserved memory specified via
	  pkernfs= cmdline argument.  Used for storing kernel state and
	  userspace memory which is preserved across kexec to support
	  live update.
```

## mm/damon/Kconfig
```kconfig
# SPDX-License-Identifier: GPL-2.0-only

menu "Data Access Monitoring"

config DAMON
	bool "DAMON: Data Access Monitoring Framework"
	help
	  This builds a framework that allows kernel subsystems to monitor
	  access frequency of each memory region. The information can be useful
	  for performance-centric DRAM level memory management.

	  See https://damonitor.github.io/doc/html/latest-damon/index.html for
	  more information.

config DAMON_VADDR
	bool "Data access monitoring primitives for virtual address spaces"
	depends on DAMON && MMU
	select PAGE_EXTENSION if !64BIT
	select PAGE_IDLE_FLAG
	help
	  This builds the default data access monitoring primitives for DAMON
	  that works for virtual address spaces.

config DAMON_PADDR
	bool "Data access monitoring primitives for the physical address space"
	depends on DAMON && MMU
	select PAGE_EXTENSION if !64BIT
	select PAGE_IDLE_FLAG
	help
	  This builds the default data access monitoring primitives for DAMON
	  that works for physical address spaces.

config DAMON_PGIDLE
	bool "Data access monitoring primitives for page granularity idleness"
	depends on DAMON && MMU
	select PAGE_EXTENSION if !64BIT
	select PAGE_IDLE_FLAG
	help
	  This builds the default data access monitoring primitives for DAMON
	  that works for page granularity idleness monitoring.

config DAMON_DBGFS
	bool "DAMON debugfs interface"
	depends on DAMON_VADDR && DAMON_PADDR && DEBUG_FS
	help
	  This builds the debugfs interface for DAMON.  The user space admins
	  can use the interface for arbitrary data access monitoring.

	  If unsure, say N.

config DAMON_RECLAIM
	bool "Build DAMON-based reclaim (DAMON_RECLAIM)"
	depends on DAMON_PADDR
	help
	  This builds the DAMON-based reclamation subsystem.  It finds pages
	  that not accessed for a long time (cold) using DAMON and reclaim
	  those if enabled.

	  This is suggested to be used as a proactive and lightweight
	  reclamation under light memory pressure, while the traditional page
	  scanning-based reclamation is used for heavy pressure.

endmenu
```
